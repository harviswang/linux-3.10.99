## arch/mips/m200/Kconfig
```kconfig
choice
    prompt "Device Tree"
    default DTB_W561A
    help
        Select the devicetree.

config DTB_W561A
    bool "W561A device tree"

endchoice

source "arch/mips/m200/linux_driver/Kconfig"
```

## arch/mips/m200/linux_driver/Kconfig
```kconfig
#
# M200 device configuration
#


#
# Serial device configuration
#

config SERIAL_M200
	tristate "Ingenic M200 SoC serial controller"
	depends on MACH_M200
	select SERIAL_CORE
	help
	  Support for the on-chip UARTs on the Ingenic M200 SoC
	  providing /dev/ttyS0, 1, 2, 3 and 4.

config SERIAL_M200_CONSOLE
	bool "Support for console on M200 serial port"
	depends on SERIAL_M200=y
	select SERIAL_CORE_CONSOLE
	---help---
	  Say Y here if you wish to use an M200 UART as the system
	  console (the system console is the device which receives all kernel
	  messages and warnings and which allows logins in single user mode).

	  Even if you say Y here, the currently visible framebuffer console
	  (/dev/tty0) will still be used as the system console by default, but
	  you can alter that using a kernel command line option such as
	  "console=ttyS0". (Try "man bootparam" or see the documentation of
	  your boot loader (lilo or loadlin) about how to pass options to the
	  kernel at boot time.)
```
